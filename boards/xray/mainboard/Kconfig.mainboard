## boards/xray/mainboard/board.yml
```yaml
board:
  name: mainboard
  full_name: X-Ray Main Board (STM32G491ME)
  socs:
    - name: stm32g491xx
```

## boards/xray/motorboard/board.yml
```yaml
board:
  name: motorboard
  full_name: X-Ray Motor Board (STM32G491ME)
  socs:
    - name: stm32g491xx
```
